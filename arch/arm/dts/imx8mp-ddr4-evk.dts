// SPDX-License-Identifier: GPL-2.0+
 /*
  * Copyright 2020 NXP
  */

#include "imx8mp-evk.dts"
//#include "imx8mp-evk-u-boot.dtsi"

/ {
	model = "NXP i.MX8MPlus DDR4 HMS board";
};

&flexspi {
	status = "disabled";
};

&gpmi {
	status = "disabled";
};


